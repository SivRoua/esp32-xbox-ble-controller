## sdkconfig.defaults
```kconfig
# 目标芯片：ESP32-S3
CONFIG_IDF_TARGET="esp32s3"

# Flash 16MB 配置 (针对 N16R8)
CONFIG_ESPTOOLPY_FLASHSIZE_16MB=y
CONFIG_ESPTOOLPY_FLASHSIZE="16MB"

# PSRAM 8MB 配置 (Octal SPI，针对 N16R8)
CONFIG_SPIRAM=y
CONFIG_SPIRAM_MODE_OCT=y
CONFIG_SPIRAM_SPEED_80M=y

# 蓝牙栈配置：启用 Apache NimBLE
CONFIG_BT_ENABLED=y
CONFIG_BT_NIMBLE_ENABLED=y
CONFIG_BT_BLUEDROID_ENABLED=n

# 启用 Central 与 Peripheral 角色及 GATT 支持
CONFIG_BT_NIMBLE_ROLE_CENTRAL=y
CONFIG_BT_NIMBLE_ROLE_PERIPHERAL=y
CONFIG_BT_NIMBLE_GATT_CLIENT=y
CONFIG_BT_NIMBLE_GATT_SERVER=y

# 提升 NimBLE 高频吞吐缓冲区容量 (防御手柄高频数据包洪峰)
CONFIG_BT_NIMBLE_MSYS_1_BLOCK_COUNT=48
CONFIG_BT_NIMBLE_MSYS_2_BLOCK_COUNT=48
CONFIG_BT_NIMBLE_TRANSPORT_ACL_FROM_LL_COUNT=64

# 启用 NimBLE HID 服务与主机支持
CONFIG_BT_NIMBLE_HID_SERVICE=y
CONFIG_BT_NIMBLE_SVC_HID_MAX_INSTANCES=2
CONFIG_BT_NIMBLE_SVC_HID_MAX_RPTS=4

# 启用较大分区表
CONFIG_PARTITION_TABLE_SINGLE_APP_LARGE=y
```
